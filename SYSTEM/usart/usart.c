#include "sys.h"
#include "usart.h"	
#include "w25qxx.h" 


//高位字节的 CRC 值
const unsigned char auchCRCHi[] = {
0x00, 0xC1, 0x81, 0x40, 0x01, 0xC0, 0x80, 0x41, 0x01, 0xC0, 0x80, 0x41,
0x00, 0xC1, 0x81,
0x40, 0x01, 0xC0, 0x80, 0x41, 0x00, 0xC1, 0x81, 0x40, 0x00, 0xC1, 0x81,
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0x00, 0xC1, 0x81,
0x40
} ;

//低位字节的 CRC 值
const char auchCRCLo[] = {
0x00, 0xC0, 0xC1, 0x01, 0xC3, 0x03, 0x02, 0xC2, 0xC6, 0x06, 0x07, 0xC7,
0x05, 0xC5, 0xC4,
0x04, 0xCC, 0x0C, 0x0D, 0xCD, 0x0F, 0xCF, 0xCE, 0x0E, 0x0A, 0xCA, 0xCB,
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0x41, 0x81, 0x80,
0x40
};

unsigned short CRC16(unsigned char *puchMsg,unsigned short usDataLen)  /* 函数以 unsigned short 类型返回 CRC */
{
	unsigned char uchCRCHi = 0xFF ;  /* CRC 的高字节初始化 */
	unsigned char uchCRCLo = 0xFF ;  /* CRC 的低字节初始化 */
	unsigned uIndex ;  /* CRC 查询表索引 */
	while (usDataLen--)  /* 完成整个报文缓冲区 */
	{
		uIndex = uchCRCLo ^ *puchMsg++ ; /* 计算 CRC */
		uchCRCLo = uchCRCHi ^ auchCRCHi[uIndex] ;
		uchCRCHi = auchCRCLo[uIndex] ;
	}
	return (uchCRCHi << 8 | uchCRCLo);
}

//////////////////////////////////////////////////////////////////
//加入以下代码,支持printf函数,而不需要选择use MicroLIB	  
#if 1
#pragma import(__use_no_semihosting)             
//标准库需要的支持函数                 
struct __FILE 
{ 
	int handle; 
}; 

//FILE __stdout;       
//定义_sys_exit()以避免使用半主机模式    
void  _sys_exit(int x) 
{ 
	x = x; 
} 
//重定义fputc函数 
int fputc(int ch, FILE *f)
{ 	
	while((USART1->SR&0X40)==0);//循环发送,直到发送完毕   
	USART1->DR = (u8) ch;      
	return ch;
}
#endif
 
#if EN_USART1_RX   //如果使能了接收

//初始化IO 串口1 
//bound:波特率
void uart_init(u32 bound){
   //GPIO端口设置
  GPIO_InitTypeDef GPIO_InitStructure;
	USART_InitTypeDef USART_InitStructure;
	NVIC_InitTypeDef NVIC_InitStructure;
	
	RCC_AHB1PeriphClockCmd(RCC_AHB1Periph_GPIOA,ENABLE); //使能GPIOA时钟
	RCC_APB2PeriphClockCmd(RCC_APB2Periph_USART1,ENABLE);//使能USART1时钟
 
	//串口1对应引脚复用映射
	GPIO_PinAFConfig(GPIOA,GPIO_PinSource9,GPIO_AF_USART1); //GPIOA9复用为USART1
	GPIO_PinAFConfig(GPIOA,GPIO_PinSource10,GPIO_AF_USART1); //GPIOA10复用为USART1
	
	//USART1端口配置
  GPIO_InitStructure.GPIO_Pin = GPIO_Pin_9 | GPIO_Pin_10; //GPIOA9与GPIOA10
	GPIO_InitStructure.GPIO_Mode = GPIO_Mode_AF;//复用功能
	GPIO_InitStructure.GPIO_Speed = GPIO_Speed_50MHz;	//速度50MHz
	GPIO_InitStructure.GPIO_OType = GPIO_OType_PP; //推挽复用输出
	GPIO_InitStructure.GPIO_PuPd = GPIO_PuPd_UP; //上拉
	GPIO_Init(GPIOA,&GPIO_InitStructure); //初始化PA9，PA10

   //USART1 初始化设置
	USART_InitStructure.USART_BaudRate = bound;//波特率设置
	USART_InitStructure.USART_WordLength = USART_WordLength_8b;//字长为8位数据格式
	USART_InitStructure.USART_StopBits = USART_StopBits_1;//一个停止位
	USART_InitStructure.USART_Parity = USART_Parity_No;//无奇偶校验位
	USART_InitStructure.USART_HardwareFlowControl = USART_HardwareFlowControl_None;//无硬件数据流控制
	USART_InitStructure.USART_Mode = USART_Mode_Rx | USART_Mode_Tx;	//收发模式
  USART_Init(USART1, &USART_InitStructure); //初始化串口1
	
  USART_Cmd(USART1, ENABLE);  //使能串口1 
	
	USART_ClearFlag(USART1, USART_FLAG_TC);
	
#if EN_USART1_RX	
	USART_ITConfig(USART1, USART_IT_RXNE, ENABLE);//开启相关中断

	//Usart1 NVIC 配置
  NVIC_InitStructure.NVIC_IRQChannel = USART1_IRQn;//串口1中断通道
	NVIC_InitStructure.NVIC_IRQChannelPreemptionPriority=3;//抢占优先级3
	NVIC_InitStructure.NVIC_IRQChannelSubPriority =2;		//子优先级3
	NVIC_InitStructure.NVIC_IRQChannelCmd = ENABLE;			//IRQ通道使能
	NVIC_Init(&NVIC_InitStructure);	//根据指定的参数初始化VIC寄存器、

#endif
	

	
}

u8 check_frame1=0;//帧头1校验标志
u8 check_frame2=0;//帧头2校验标志
u16 data_len=0;//接收到数据长度
u16 pageIndex=0;//存储页面
u16 bagIndex=0;//当前第几包
u16 sumBag=0;
u32 writeAddrFlash=0;
 u8 sendbuf[7]={0x5A,0xA5,0x04,0x05,0xFF,0x42,0xA0};//回复成功
int USART1_IRQHandler(void)
{    
    if(USART_GetITStatus(USART1, USART_IT_RXNE) != RESET) //Check if data is received 
    {
        u8 Usart_Receive;
        static u16 Count;
        static u8 rxbuf[MAX_REC_LEN];
       
        int check=0,i,j;
        
        Usart_Receive = USART_ReceiveData(USART1); //Read the data 
     
        //Fill the array with serial data
        rxbuf[Count] = Usart_Receive;  
        
       if(check_frame1==1&&check_frame2==1) Count++;
        //判断帧头
			if(Usart_Receive == FRAME_HEADER1 ||check_frame1==1)
			{
				 check_frame1=1;
				 if(Usart_Receive == FRAME_HEADER2||check_frame2==1) 
				 {
					
					 check_frame2=1;
				 }             
				else if(Usart_Receive != FRAME_HEADER1 )
				{
					Count=0;
					check_frame1=0;
					check_frame2=0;
				}           
			}
			else 
			{
				Count=0;
				check_frame1=0;
				check_frame2=0;
			}
			
				
			if(Count==2)//获取长度
			{
				data_len=rxbuf[0]<<8|rxbuf[1];
			}
       
			if (Count == data_len && data_len>0) //接收所有数据
			{          
					check=rxbuf[data_len - 2]|rxbuf[data_len - 1]<<8;
					//校验
					if(check == CRC16(&rxbuf[2],data_len -4))
					{   
						pageIndex=rxbuf[2]<<8|rxbuf[3];
						bagIndex=rxbuf[4]<<8|rxbuf[5];
						//sumBag=rxbuf[6]<<8|rxbuf[7];
						
						
						//写入音频到flash  0*512k:欢迎使用  1M:音量加  2M:音量减	
						writeAddrFlash=512*pageIndex*1024 +bagIndex*4096;
						W25QXX_Erase_Sector(writeAddrFlash/4096);//擦除这个扇区
						W25QXX_Write_NoCheck(&rxbuf[8],writeAddrFlash,4096);//写入整个扇区  
						delay_ms(5);
						
						for(j=0; j < 7; j++)
						{
								usart1_send(sendbuf[j]);//回复收到
						}
					}
					Count=0;
					check_frame1=0;
					check_frame2=0;
			}
         
        
    }
    return 0;    
}

void usart1_send(u8 data)
{
    USART1->DR = data;
    while((USART1->SR&0x40)==0);    
}

#endif	

 



